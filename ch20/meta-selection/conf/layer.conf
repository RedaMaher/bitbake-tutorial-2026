## ch20/meta-selection/conf/layer.conf
```bitbake
BBPATH .= ":${LAYERDIR}"
BBFILES += "${LAYERDIR}/recipes-*/*/*.bb"
BBFILE_COLLECTIONS += "selection"
BBFILE_PATTERN_selection = "^${LAYERDIR}/"
BBFILE_PRIORITY_selection = "7"
LAYERSERIES_COMPAT_selection = "bitbakeguide"
LAYERDEPENDS_selection = "tutorial"

BBFILES_DYNAMIC += "two:${LAYERDIR}/dynamic/two/recipes-*/*/*.bbappend"
```
